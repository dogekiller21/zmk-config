

&uart0 {
    status = "okay";
    current-speed = <115200>;
    pinctrl-0 = <&uart0_left_central_default>;
    pinctrl-names = "default";
};

&pinctrl {
    uart0_left_central_default: uart0_left_central_default {
        group1 {
            /* TX = P0.08, RX = P0.06 */
            psels = <NRF_PSEL(UART_TX, 0, 8)>, <NRF_PSEL(UART_RX, 0, 6)>;
        };
    };
}
