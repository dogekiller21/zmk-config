/* RIGHT (peripheral)
 *
 * Purpose:
 * - Enable UART0 and assign mirrored TX/RX pins for the wired split link.
 * - Peripheral side does NOT expose USB HID; it forwards key events to the central.
 *
 * Notes:
 * - Pins are mirrored so a straight TRRS cable crosses TX<->RX naturally across halves.
 * - Keep TRRS to three lines only: GND, TX, RX. Do NOT route VCC over TRRS.
 */

&uart0 {
    status = "okay";
    current-speed = <115200>;
    pinctrl-0 = <&uart0_right_peripheral_default>;
    pinctrl-names = "default";
};

&pinctrl {
    uart0_right_peripheral_default: uart0_right_peripheral_default {
        group1 {
            /* UART TX = P0.06, UART RX = P0.08 on the RIGHT (peripheral) half */
            psels = <NRF_PSEL(UART_TX, 0, 6)>, <NRF_PSEL(UART_RX, 0, 8)>;
        };
    };
}